## linux-4.4.121-92.92/Documentation/devicetree/bindings/mmc/brcm,bcm2835-sdhost.txt
```
Broadcom BCM2835 SDHOST controller

This file documents differences between the core properties described
by mmc.txt and the properties that represent the BCM2835 controller.

Required properties:
- compatible: Should be "brcm,bcm2835-sdhci".
- clocks: The clock feeding the SDHOST controller.

Optional properties:
- dmas: DMA channels for read and write.
          See Documentation/devicetree/bindings/dma/dma.txt for details

Example:

sdhost: sdhost@7e202000 {
	compatible = "brcm,bcm2835-sdhost";
	reg = <0x7e202000 0x100>;
	interrupts = <2 24>;
	clocks = <&clocks BCM2835_CLOCK_VPU>;
	dmas = <&dma 13>,
	       <&dma 13>;
	dma-names = "tx", "rx";
};
```

## linux-4.4.121-92.92/Documentation/devicetree/bindings/thermal/raspberrypi,bcm2835-thermal.txt
```
Raspberry Pi Broadcom BCM2835 thermal control

Required properties:

- compatible : should be "raspberrypi,bcm2835-thermal"
- firmware : the Raspberry Pi firmware node

Example:

thermal {
	compatible = "raspberrypi,bcm2835-thermal";
	firmware = <&firmware>;
};
```
